# file: LCD_lib2.ioc
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Mcu.Family=STM32F1
Mcu.Name=STM32F103C(8-B)Tx
Mcu.Package=LQFP48
NVIC.PriorityGroup=NVIC_PRIORITYGROUP_4
ProjectManager.HeapSize=0x200
ProjectManager.StackSize=0x400
ProjectManager.TargetToolchain=MDK-ARM V5
RCC.AHBCLKDivider=RCC_SYSCLK_DIV8
RCC.AHBFreq_Value=1000000
RCC.APB1Freq_Value=1000000
RCC.APB1TimFreq_Value=1000000
RCC.APB2Freq_Value=1000000
RCC.APB2TimFreq_Value=1000000
RCC.HCLKFreq_Value=1000000
VP_SYS_VS_ND.Mode=No_Debug
board=custom

// file: Src/main.c
/* USER CODE BEGIN Header */
/**
  ******************************************************************************
  * @file           : main.c
  * @brief          : Main program body
  ******************************************************************************
  * @attention
  *
  * <h2><center>&copy; Copyright (c) 2019 STMicroelectronics.
  * All rights reserved.</center></h2>
  *
  * This software component is licensed by ST under BSD 3-Clause license,
  * the "License"; You may not use this file except in compliance with the
  * License. You may obtain a copy of the License at:
  *                        opensource.org/licenses/BSD-3-Clause
  *
  ******************************************************************************
  */
/* USER CODE END Header */

#include "main.h"

/* USER CODE BEGIN Includes */
#include "LCD.h"
#include "string.h"
#include <stdio.h>
/* USER CODE END Includes */

void SystemClock_Config(void);

int main(void)
{

  /* MCU Configuration--------------------------------------------------------*/

  /* Reset of all peripherals, Initializes the Flash interface and the Systick. */
  HAL_Init();

  /* Configure the system clock */
  SystemClock_Config();

  /* USER CODE BEGIN SysInit */
  MyLCD lcd('A',7,6,5,4,3,2);					//set the pins that connect the lcd to the MCU: (connected to port D, D7 of the LCD is connected to pin 7 or PORT D, D6 of the LCD is connected to pin 6 or PORT D, D5 of the LCD is connected to pin 5 or PORT D, D4 of the LCD is connected to RS or PORT D, D7 of the LCD is connected to pin 3 or PORT D, E of the LCD is connected to pin 2 or PORT D)
  lcd.init(2,1,0);							//set up the LCD, the LCD has 2 lines, show the cursor underline , don't blink (those are the same as the default arguments so if you just called init(); it would have had the same parameter, hence same effect)

  char customChar0[] = {0,14,21,23,17,14,0,0};//clock
  char customChar1[] = {10,10,31,31,14,4,4,0};//fesha
  char customChar2[] = {4,4,31,0,14,4,4,0};	//capacitor
  char customChar3[] = {0,10,10,0,17,14,0,0};	//smiley face

	//define new graphs or characters (use this site to create the string array needed: https://www.quinapalus.com/hd44780udg.html
	uint8_t clock_handler=lcd.defineGraph(customChar0);	//clock
	uint8_t fesha_handler=lcd.defineGraph(customChar1);	//fesha
	uint8_t cap_handler  =lcd.defineGraph(customChar2);	//capacitor
	uint8_t Sface_handler=lcd.defineGraph(customChar3);	//smiley face

	lcd.clear();		//clear the display since defineGraph() misses with display
	lcd.home();			//rest display position and remove any shifts
	lcd.setCursor(0,0);	//this is useless since home() restes diplay posithion

	lcd.data();								//must tell the LCD that you'll be sending data() if you want to use writeChar() [writeChar() could be used to send command() as well]
	lcd.writeChar(Sface_handler);			//send a char to the lcd (whether this char is a command() or data() is set by thes two APIs)
	lcd.print(" Hello ");					//print a char* (this is an overloaded function that can handle char, char* and vlist)
	lcd.print(Sface_handler);				//print a char  (this is an overloaded function that can handle char, char* and vlist)
	lcd.setCursor(1,0);						//go to the first pixel of line 1 (second line)
	lcd.print("defined chars: %c %c %c %c",clock_handler,Sface_handler,fesha_handler,cap_handler);//print a vlist very much the same as printf (this is an overloaded function that can handle char, char* and vlist)
	HAL_Delay(300);
  /* USER CODE END SysInit */

  /* Initialize all configured peripherals */

  /* Infinite loop */
  while (1)
  {
	 lcd.shiftR(6,100);					//shift the visible part of the LCD 6 times to the Right with a 100ms delay between each single shift
	HAL_Delay(200);
	lcd.shiftL(6,100);					//shift the visible part of the LCD 6 times to the Right with a 100ms delay between each single shift
	HAL_Delay(200);
  }
}

void SystemClock_Config(void)
{
  RCC_OscInitTypeDef RCC_OscInitStruct = {0};
  RCC_ClkInitTypeDef RCC_ClkInitStruct = {0};

  /** Initializes the CPU, AHB and APB busses clocks
  */
  RCC_OscInitStruct.OscillatorType = RCC_OSCILLATORTYPE_HSI;
  RCC_OscInitStruct.HSIState = RCC_HSI_ON;
  RCC_OscInitStruct.HSICalibrationValue = RCC_HSICALIBRATION_DEFAULT;
  RCC_OscInitStruct.PLL.PLLState = RCC_PLL_NONE;
  if (HAL_RCC_OscConfig(&RCC_OscInitStruct) != HAL_OK)
  {
    Error_Handler();
  }
  /** Initializes the CPU, AHB and APB busses clocks
  */
  RCC_ClkInitStruct.ClockType = RCC_CLOCKTYPE_HCLK|RCC_CLOCKTYPE_SYSCLK
                              |RCC_CLOCKTYPE_PCLK1|RCC_CLOCKTYPE_PCLK2;
  RCC_ClkInitStruct.SYSCLKSource = RCC_SYSCLKSOURCE_HSI;
  RCC_ClkInitStruct.AHBCLKDivider = RCC_SYSCLK_DIV8;
  RCC_ClkInitStruct.APB1CLKDivider = RCC_HCLK_DIV1;
  RCC_ClkInitStruct.APB2CLKDivider = RCC_HCLK_DIV1;

  if (HAL_RCC_ClockConfig(&RCC_ClkInitStruct, FLASH_LATENCY_0) != HAL_OK)
  {
    Error_Handler();
  }
}

void Error_Handler(void)
{
}

/************************ (C) COPYRIGHT STMicroelectronics *****END OF FILE****/
